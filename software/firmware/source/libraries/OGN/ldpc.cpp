#include <stdint.h>
#include <stdlib.h>

#include "ldpc.h"

#ifndef __AVR__
#include <math.h>
#endif

#ifdef __AVR__
#include <avr/pgmspace.h>
#endif

// ===================================================================================================================

// FindVectors65432bit(10,20,23, 500) => 208, Delta=2579

// every row represents a parity check to be performed on the received codeword
static const uint32_t LDPC_ParityCheck_n208k160[48][7]
#ifdef __AVR__
PROGMEM
#endif
= { // parity check vectors: 48 vectors for 48 parity checks
    // Eaech vector applied to the data packet should yield even number of bits
 { 0x00000805, 0x00000020, 0x04000000, 0x20000000, 0x00000040, 0x00044020, 0x00000000 },
 { 0x00000001, 0x00800800, 0x00000000, 0x00000000, 0x00000000, 0x10010000, 0x00008C98 },
 { 0x00004001, 0x01000080, 0x80000400, 0x00000000, 0x08000200, 0x00200000, 0x00000005 },
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 { 0x00000000, 0x00101000, 0x08000001, 0x02000200, 0x82004A80, 0x00004000, 0x00000202 }
} ;


const uint8_t LDPC_ParityCheckIndex_n208k160[48][24]
#ifdef __AVR__
PROGMEM
#endif
= { // number of, indicies to bits to be taken for parity checks
 { 10,   0,   2,  11,  37,  90, 125, 134, 165, 174, 178 },
 { 11,   0,  43,  55, 176, 188, 195, 196, 199, 202, 203, 207 },
 { 11,   0,  14,  39,  56,  74,  95, 137, 155, 181, 192, 194, },
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 { 15,  44,  52,  64,  91, 105, 121, 135, 137, 139, 142, 153, 159, 174, 193, 201 }
  } ;

static const uint8_t LDPC_BitWeight_n208k160[208] // weight of parity checks for every codeword bit
#ifdef __AVR__
PROGMEM
#endif
= { 6, 3, 6, 3, 3, 3, 3, 3, 4, 3, 4, 6, 3, 3, 5, 3, 3, 3, 3, 3, 3, 3, 3, 3, 3, 3, 3, 3, 3, 3, 3, 3,
    3, 3, 3, 3, 3, 6, 3, 5, 3, 5, 3, 5, 3, 3, 3, 3, 3, 3, 3, 3, 3, 3, 3, 5, 5, 3, 3, 3, 3, 5, 3, 3,
    3, 4, 3, 3, 3, 4, 3, 3, 4, 3, 4, 4, 3, 3, 4, 3, 3, 3, 3, 3, 3, 3, 3, 3, 3, 3, 6, 3, 3, 3, 3, 5,
    3, 3, 3, 3, 3, 4, 3, 3, 3, 3, 3, 3, 3, 3, 3, 3, 3, 3, 3, 3, 3, 3, 3, 3, 3, 3, 3, 3, 3, 6, 3, 3,
    3, 3, 3, 3, 3, 3, 6, 3, 3, 5, 3, 3, 3, 3, 3, 3, 3, 3, 3, 3, 3, 3, 3, 3, 3, 3, 3, 5, 3, 3, 3, 3,
    4, 3, 3, 4, 3, 6, 3, 3, 4, 4, 3, 3, 3, 3, 3, 3, 5, 3, 6, 3, 3, 5, 4, 4, 3, 3, 4, 4, 5, 3, 4, 4,
    5, 4, 5, 5, 5, 4, 3, 5, 3, 3, 6, 5, 4, 3, 4, 5 } ;

// every row represents the generator for a parity bit
static const uint32_t LDPC_ParityGen_n208k160[48][5]
#ifdef __AVR__
PROGMEM
#endif
= { // Parity bits generator: 48 vectors to generate 48 parity bits
    // Each vector applied to the user data yields a corresponding parity bit
 { 0x40A90281, 0x9159D249, 0xCE9D516B, 0x2FDEED0B, 0xD9267CD4  },
 { 0xCCBC0FC3, 0xCC4FA4BC, 0x811EC3D0, 0xB07EC1B3, 0xA3B8E8D8  },
 { 0x66418D56, 0x3B85ADFF, 0xD2A6532E, 0x48CF52E4, 0x6A16586D  },
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 { 0x55CD3406, 0x5E1F7407, 0x63F2D35A, 0x5ACAFEA4, 0x7E48A8DF  }
} ;


// ===================================================================================================================

#ifdef WITH_PPM

const uint32_t LDPC_ParityCheck_n354k160[194][12] // 354 codeword = 160 user bits + 194 parity checks
#ifdef __AVR__
PROGMEM
#endif
= { // parity check vectors
 { 0x00000000, 0x00000000, 0x00000000, 0x28000000, 0x00000000, 0x00000000, 0x00000400, 0x00E00006, 0x00000000, 0x00000080, 0x00000000, 0x00000000 }, 
 { 0x00000000, 0x00000000, 0x00000000, 0x00000000, 0x00000000, 0x80000000, 0x000C0040, 0x00010000, 0x00180000, 0x00000000, 0x40000040, 0x00000000 }, 
 { 0x00000000, 0x00000000, 0x00000000, 0x00000000, 0x20003000, 0x58000000, 0x00000000, 0x00000000, 0x00010000, 0x00000000, 0x30000000, 0x00000000 }, 
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 { 0x00100082, 0x00000000, 0x20008000, 0x00000000, 0x00000000, 0x00004000, 0x00000800, 0x00000000, 0x00000000, 0x00001000, 0x00000000, 0x00000002 }  
} ;

const uint32_t LDPC_ParityGen_n354k160[194][5]
#ifdef __AVR__
PROGMEM
#endif
= { // parity bits generator
 { 0xBF3B0B3C, 0x314E4CB2, 0x1C4219B8, 0xF87E8234, 0x6D121C05  }, 
 { 0x43C31BD3, 0xA49EE0D2, 0xB613CA26, 0x4A06EB31, 0xBBBC4B69  }, 
 { 0xA8E96C9C, 0x5C4BD117, 0x8877A3B7, 0x2C28FCBB, 0xC20F5C52  }, 
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 { 0x1972680C, 0xC53F300C, 0xCF1C1DE5, 0x1A7ED516, 0xDBC46D76  }  
} ;

#endif // WITH_PPM

// ===================================================================================================================

#ifdef __AVR__

// encode Parity from Data: Data is 5x 32-bit words = 160 bits, Parity is 1.5x 32-bit word = 48 bits
void LDPC_Encode(const uint32_t *Data, uint32_t *Parity, const uint32_t ParityGen[48][5])
{ uint8_t ParIdx=0; Parity[ParIdx]=0; uint32_t Mask=1;
  for(uint8_t Row=0; Row<48; Row++)
  { uint8_t Count=0;
    const uint32_t *Gen=ParityGen[Row];
    for(uint8_t Idx=0; Idx<5; Idx++)
    { Count+=Count1s(Data[Idx]&pgm_read_dword(Gen+Idx)); }
    if(Count&1) Parity[ParIdx]|=Mask; Mask<<=1;
    if(Mask==0) { ParIdx++; Parity[ParIdx]=0; Mask=1; }
  }
}

void LDPC_Encode(const uint32_t *Data, uint32_t *Parity)
{ LDPC_Encode(Data, Parity, LDPC_ParityGen); }

// encode Parity from Data: Data is 20 bytes = 160 bits, Parity is 6 bytes = 48 bits
void LDPC_Encode(const uint8_t *Data, uint8_t *Parity, const uint32_t ParityGen[48][5])
{ uint8_t ParIdx=0; Parity[ParIdx]=0; uint8_t Mask=1;
  for(uint8_t Row=0; Row<48; Row++)
  { uint8_t Count=0;
    const uint8_t *Gen = (uint8_t *)ParityGen[Row];
    for(uint8_t Idx=0; Idx<20; Idx++)
    { Count+=Count1s(Data[Idx]&pgm_read_byte(Gen+Idx)); }
    if(Count&1) Parity[ParIdx]|=Mask; Mask<<=1;
    if(Mask==0) { ParIdx++; Parity[ParIdx]=0; Mask=1; }
  }
}

void LDPC_Encode(const uint8_t *Data, uint8_t *Parity)
{ LDPC_Encode(Data, Parity, LDPC_ParityGen); }

void LDPC_Encode(uint8_t *Data)
{ LDPC_Encode(Data, Data+20, LDPC_ParityGen); }

// check Data against Parity (run 48 parity checks) - return number of failed checks
int8_t LDPC_Check(const uint8_t *Data) // 20 data bytes followed by 6 parity bytes
{ uint8_t Errors=0;
  for(uint8_t Row=0; Row<48; Row++)
  { uint8_t Count=0;
    const uint8_t *Check = (uint8_t *)LDPC_ParityCheck[Row];
    for(uint8_t Idx=0; Idx<26; Idx++)
    { Count+=Count1s(Data[Idx] & pgm_read_byte(Check+Idx)); }
    if(Count&1) Errors++; }
  return Errors; }

int8_t LDPC_Check(const uint32_t *Packet)
{ return LDPC_Check( (uint8_t *)Packet ); }

#else // if not 8-bit AVR

void LDPC_Encode(const uint8_t *Data, uint8_t *Parity, const uint32_t ParityGen[48][5])
{ uint8_t ParIdx=0; uint8_t ParByte=0; uint8_t Mask=1;
  for(uint8_t Row=0; Row<48; Row++)
  { uint8_t Count=0;
    const uint8_t *Gen = (uint8_t *)(ParityGen[Row]);
    for(uint8_t Idx=0; Idx<20; Idx++)
    { Count+=Count1s((uint8_t)(Data[Idx]&Gen[Idx])); }
    if(Count&1) ParByte|=Mask; Mask<<=1;
    if(Mask==0) { Parity[ParIdx++]=ParByte; Mask=1; ParByte=0; }
  }
  // if(Mask!=1) Parity[ParIdx]=ParByte;
}

void LDPC_Encode(const uint8_t *Data, uint8_t *Parity)
{ LDPC_Encode(Data, Parity, LDPC_ParityGen_n208k160); }

void LDPC_Encode(uint8_t *Data)
{ LDPC_Encode(Data, Data+20); }

// encode Parity from Data: Data is 5x 32-bit words = 160 bits, Parity is 1.5x 32-bit word = 48 bits
static void LDPC_Encode(const uint32_t *Data, uint32_t *Parity, uint8_t DataWords,  uint8_t Checks, const uint32_t *ParityGen)
{ // printf("LDPC_Encode: %08X %08X %08X %08X %08X", Data[0], Data[1], Data[2], Data[3], Data[4] );
  uint8_t ParIdx=0; Parity[ParIdx]=0; uint32_t Mask=1;
  const uint32_t *Gen=ParityGen;
  for(uint8_t Row=0; Row<Checks; Row++)
  { uint8_t Count=0;
    for(uint8_t Idx=0; Idx<DataWords; Idx++)
    { Count+=Count1s(Data[Idx]&Gen[Idx]); }
    if(Count&1) Parity[ParIdx]|=Mask; Mask<<=1;
    if(Mask==0) { ParIdx++; Parity[ParIdx]=0; Mask=1; }
    Gen+=DataWords; }
  // printf(" => %08X %08X\n", Parity[0], Parity[1] );
}

void LDPC_Encode(const uint32_t *Data, uint32_t *Parity) { LDPC_Encode(Data, Parity, 5, 48, (uint32_t *)LDPC_ParityGen_n208k160); }
void LDPC_Encode(      uint32_t *Data)                   { LDPC_Encode(Data, Data+5, 5, 48, (uint32_t *)LDPC_ParityGen_n208k160); }

#ifdef WITH_PPM
void LDPC_Encode_n354k160(const uint32_t *Data, uint32_t *Parity) { LDPC_Encode(Data, Parity, 5, 194, (uint32_t *)LDPC_ParityGen_n354k160); }
void LDPC_Encode_n354k160(      uint32_t *Data)                   { LDPC_Encode(Data, Data+5, 5, 194, (uint32_t *)LDPC_ParityGen_n354k160); }
#endif

// check Data against Parity (run 48 parity checks) - return number of failed checks
uint8_t LDPC_Check(const uint32_t *Data, const uint32_t *Parity) // Data and Parity are 32-bit words
{ uint8_t Errors=0;
  for(uint8_t Row=0; Row<48; Row++)
  { uint8_t Count=0;
    const uint32_t *Check=LDPC_ParityCheck_n208k160[Row];
    uint8_t Idx;
    for(Idx=0; Idx<5; Idx++)
    { Count+=Count1s(Data[Idx]&Check[Idx]); }
    Count+=Count1s(Parity[0]&Check[Idx++]);
    Count+=Count1s((Parity[1]&Check[Idx++])&0xFFFF);
    if(Count&1) Errors++; }
  return Errors; }

uint8_t LDPC_Check(const uint32_t *Data) { return LDPC_Check(Data, Data+5); }

uint8_t LDPC_Check(const uint8_t *Data) // 20 data bytes followed by 6 parity bytes
{ uint8_t Errors=0;
  for(uint8_t Row=0; Row<48; Row++)
  { uint8_t Count=0;
    const uint8_t *Check = (uint8_t *)LDPC_ParityCheck_n208k160[Row];
    for(uint8_t Idx=0; Idx<26; Idx++)
    { uint8_t And = Data[Idx]&Check[Idx]; Count+=Count1s(And); }
    if(Count&1) Errors++; }
  return Errors; }
#ifdef WITH_PPM
uint8_t LDPC_Check_n354k160(const uint32_t *Data, const uint32_t *Parity) // Data and Parity are 32-bit words
{ uint8_t Errors=0;
  for(uint8_t Row=0; Row<194; Row++)
  { uint8_t Count=0;
    const uint32_t *Check=LDPC_ParityCheck_n354k160[Row];
    uint8_t Idx;
    for(Idx=0; Idx<5; Idx++)
    { Count+=Count1s(Data[Idx]&Check[Idx]); }
    uint8_t ParIdx;
    for(ParIdx=0; ParIdx<6; ParIdx++, Idx++)
    { Count+=Count1s(Parity[ParIdx]&Check[Idx]); }
    Count+=Count1s((Parity[ParIdx]&Check[Idx])&0x0003);
    if(Count&1) Errors++; }
  return Errors; }

uint8_t LDPC_Check_n354k160(const uint32_t *Data) { return LDPC_Check_n354k160(Data, Data+5); }
#endif // WITH_PPM

#endif // __AVR__

